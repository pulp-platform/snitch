/* Copyright 2020 ETH Zurich and University of Bologna. */
/* Solderpad Hardware License, Version 0.51, see LICENSE for details. */
/* SPDX-License-Identifier: SHL-0.51 */

MEMORY
{
    L3 (rwxa) : ORIGIN = 0x80000000, LENGTH = 0x80000000
}
